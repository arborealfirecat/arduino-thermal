#include "T4_V13.h"
#include <TFT_eSPI.h>
#include <SPI.h>
#include "WiFi.h"
#include <Wire.h>
#include <Ticker.h>
#include <Button2.h>
#include <SD.h>
#include <Adafruit_MLX90640.h>

TFT_eSPI tft = TFT_eSPI(); // Invoke custom library
Adafruit_MLX90640 mlx;

SPIClass sdSPI(VSPI);
#define IP5306_ADDR         0X75
#define IP5306_REG_SYS_CTL0 0x00

#define MINTEMP 20
#define MAXTEMP 35

uint8_t state = 0;
char buff[512];
float frame[32*24];
uint16_t displayPixelWidth, displayPixelHeight;
const uint16_t camColors[] = {0x480F,
0x400F,0x400F,0x400F,0x4010,0x3810,0x3810,0x3810,0x3810,0x3010,0x3010,
0x3010,0x2810,0x2810,0x2810,0x2810,0x2010,0x2010,0x2010,0x1810,0x1810,
0x1811,0x1811,0x1011,0x1011,0x1011,0x0811,0x0811,0x0811,0x0011,0x0011,
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0xF080,0xF060,0xF040,0xF020,0xF800,};

void setup() {
    Serial.begin(115200);
    delay(1000);

    //Pin out Dump
    Serial.printf("Current select %s version\n", BOARD_VRESION);
    Serial.printf("TFT_MISO:%d\n", TFT_MISO);
    Serial.printf("TFT_MOSI:%d\n", TFT_MOSI);
    Serial.printf("TFT_SCLK:%d\n", TFT_SCLK);
    Serial.printf("TFT_CS:%d\n", TFT_CS);
    Serial.printf("TFT_DC:%d\n", TFT_DC);
    Serial.printf("TFT_RST:%d\n", TFT_RST);
    Serial.printf("TFT_BL:%d\n", TFT_BL);
    Serial.printf("SD_MISO:%d\n", SD_MISO);
    Serial.printf("SD_MOSI:%d\n", SD_MOSI);
    Serial.printf("SD_SCLK:%d\n", SD_SCLK);
    Serial.printf("SD_CS:%d\n", SD_CS);
    Serial.printf("I2C_SDA:%d\n", I2C_SDA);
    Serial.printf("I2C_SCL:%d\n", I2C_SCL);
    Serial.printf("SPEAKER_PWD:%d\n", SPEAKER_PWD);
    Serial.printf("SPEAKER_OUT:%d\n", SPEAKER_OUT);
    Serial.printf("ADC_IN:%d\n", ADC_IN);
    Serial.printf("BUTTON_1:%d\n", BUTTON_1);
    Serial.printf("BUTTON_2:%d\n", BUTTON_2);
    Serial.printf("BUTTON_3:%d\n", BUTTON_3);
#ifdef BUTTON_4
    Serial.printf("BUTTON_4:%d\n", BUTTON_4);
#endif

    tft.init();
    tft.setRotation(0);
    tft.fillScreen(TFT_BLACK);
    tft.setTextSize(1);
    tft.setTextColor(TFT_WHITE);
    tft.setTextFont(1);
    tft.setCursor(0, 0);

    if (TFT_BL > 0) {
        pinMode(TFT_BL, OUTPUT);
        digitalWrite(TFT_BL, HIGH);
    }

    if (I2C_SDA > 0) {
        Wire.begin(I2C_SDA, I2C_SCL);
    }

    Serial.println("Adafruit MLX9060 Test");
    if (!mlx.begin(MLX90640_I2CADDR_DEFAULT, &Wire)) {
      Serial.println("MLX90640 not found");
      while (1) delay(10);
    }
    Serial.println("Found Adafruit MLX90640");

    // Sensor Mode
    // mlx.setMode(MLX90640_INTERLEAVED);
    mlx.setMode(MLX90640_CHESS); // chess view (grid with boxes)

    // Set resolution 16, 17, 18 or 19
    mlx.setResolution(MLX90640_ADC_18BIT);

    // Set refresh rate
    mlx.setRefreshRate(MLX90640_2_HZ);

    displayPixelWidth = tft.width() / 32;
    displayPixelHeight = tft.height() / 32;
    Serial.print("Height: "); Serial.println(tft.height());
    Serial.print("Width: "); Serial.println(tft.width());
//    Wire.setClock(1000000); // max 1 MHz
}


void loop() {
    delay(500); // let the camera warm up
    // get IR frame
    if (mlx.getFrame(frame) != 0) {
      Serial.println("failed to load frame from lens");
      return;
    }

    Serial.println();

    for (uint8_t h = 0; h < 24; h++) {
      for (uint8_t w = 0; w < 32; w++) {
        float t = frame[h*32 + w];

        t = min<float>(t, MAXTEMP);
        t = max<float>(t, MINTEMP);
        uint8_t colorIndex = map(t, MINTEMP, MAXTEMP, 0, 255);
        tft.fillRect(displayPixelWidth * w, displayPixelHeight * h, displayPixelHeight, displayPixelWidth, camColors[colorIndex]);
      }
    }
}